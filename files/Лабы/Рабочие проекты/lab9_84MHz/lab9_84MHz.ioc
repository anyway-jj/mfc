# file: lab9_84MHz.ioc
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Mcu.Family=STM32F4
Mcu.Name=STM32F401C(B-C)Ux
Mcu.Package=UFQFPN48
NVIC.PriorityGroup=NVIC_PRIORITYGROUP_4
ProjectManager.HeapSize=0x200
ProjectManager.StackSize=0x400
ProjectManager.TargetToolchain=STM32CubeIDE
RCC.AHBFreq_Value=16000000
RCC.APB1Freq_Value=16000000
RCC.APB2Freq_Value=16000000
RCC.CortexFreq_Value=16000000
RCC.HSE_VALUE=25000000
RCC.HSI_VALUE=16000000
RCC.LSE_VALUE=32768
RCC.SYSCLKFreq_VALUE=16000000
RCC.VCOOutputFreq_Value=192000000
board=custom

// file: Core/Src/main.c
/* USER CODE BEGIN Header */
/**
  ******************************************************************************
  * @file           : main.c
  * @brief          : Main program body
  ******************************************************************************
  * @attention
  *
  * Copyright (c) 2023 STMicroelectronics.
  * All rights reserved.
  *
  * This software is licensed under terms that can be found in the LICENSE file
  * in the root directory of this software component.
  * If no LICENSE file comes with this software, it is provided AS-IS.
  *
  ******************************************************************************
  */
/* USER CODE END Header */
#include "main.h"

/* USER CODE BEGIN PV */
char array[] = "Hello world! ";
/* USER CODE END PV */

void SystemClock_Config(void);
/* USER CODE BEGIN PFP */
void ENABLE_84MHz(void);
/* USER CODE END PFP */

int main(void)
{

  /* MCU Configuration--------------------------------------------------------*/

  /* Reset of all peripherals, Initializes the Flash interface and the Systick. */
  HAL_Init();

  /* Configure the system clock */
  SystemClock_Config();

  /* Initialize all configured peripherals */
  /* USER CODE BEGIN 2 */
  ENABLE_84MHz();
  RCC->AHB1ENR |= RCC_AHB1ENR_GPIOAEN;
  RCC->APB2ENR |= RCC_APB2ENR_USART1EN;

  GPIOA->AFR[1] |= (0b0111 << GPIO_AFRH_AFSEL10_Pos) | (0b0111 << GPIO_AFRH_AFSEL9_Pos);
  GPIOA->MODER |= (0b10 << GPIO_MODER_MODE10_Pos) | (0b10 << GPIO_MODER_MODE9_Pos);

  USART1->CR1 = USART_CR1_UE | USART_CR1_RE | USART_CR1_TE;
  USART1->BRR = 8750;
  /* USER CODE END 2 */

  /* Infinite loop */
  while (1)
  {

    /* USER CODE BEGIN 3 */
	for (int i = 0; i < sizeof(array) - 1; i++) {
		while ((USART1->SR & USART_SR_TXE_Msk) != USART_SR_TXE_Msk);
		USART1->DR = array[i];
	}
	for (int i = 0; i < 500000; i++);
  }
  /* USER CODE END 3 */
}

void SystemClock_Config(void)
{
  RCC_OscInitTypeDef RCC_OscInitStruct = {0};
  RCC_ClkInitTypeDef RCC_ClkInitStruct = {0};

  /** Configure the main internal regulator output voltage
  */
  __HAL_RCC_PWR_CLK_ENABLE();
  __HAL_PWR_VOLTAGESCALING_CONFIG(PWR_REGULATOR_VOLTAGE_SCALE2);

  /** Initializes the RCC Oscillators according to the specified parameters
  * in the RCC_OscInitTypeDef structure.
  */
  RCC_OscInitStruct.OscillatorType = RCC_OSCILLATORTYPE_HSI;
  RCC_OscInitStruct.HSIState = RCC_HSI_ON;
  RCC_OscInitStruct.HSICalibrationValue = RCC_HSICALIBRATION_DEFAULT;
  RCC_OscInitStruct.PLL.PLLState = RCC_PLL_NONE;
  if (HAL_RCC_OscConfig(&RCC_OscInitStruct) != HAL_OK)
  {
    Error_Handler();
  }

  /** Initializes the CPU, AHB and APB buses clocks
  */
  RCC_ClkInitStruct.ClockType = RCC_CLOCKTYPE_HCLK|RCC_CLOCKTYPE_SYSCLK
                              |RCC_CLOCKTYPE_PCLK1|RCC_CLOCKTYPE_PCLK2;
  RCC_ClkInitStruct.SYSCLKSource = RCC_SYSCLKSOURCE_HSI;
  RCC_ClkInitStruct.AHBCLKDivider = RCC_SYSCLK_DIV1;
  RCC_ClkInitStruct.APB1CLKDivider = RCC_HCLK_DIV1;
  RCC_ClkInitStruct.APB2CLKDivider = RCC_HCLK_DIV1;

  if (HAL_RCC_ClockConfig(&RCC_ClkInitStruct, FLASH_LATENCY_0) != HAL_OK)
  {
    Error_Handler();
  }
}

/* USER CODE BEGIN 4 */
void ENABLE_84MHz(void) {
  FLASH->ACR |= (0b0010 << FLASH_ACR_LATENCY_Pos);
  while( (FLASH->ACR & 0b0010) != 0b0010);

  RCC->CR = RCC_CR_HSEON;
  while ((RCC->CR & RCC_CR_HSERDY) != RCC_CR_HSERDY);

  //PPLM = 25, PPLN = 336, PPLP = 4, SOURCE - HSE 25 MHz, PPLQ = 7
  RCC->PLLCFGR = (0b011001 << RCC_PLLCFGR_PLLM_Pos) | (0b101010000 << RCC_PLLCFGR_PLLN_Pos) |
		             (0b01 << RCC_PLLCFGR_PLLP_Pos) | (0b1 << RCC_PLLCFGR_PLLSRC_Pos) | (0b0111 << RCC_PLLCFGR_PLLQ_Pos);
  RCC->CR |= RCC_CR_PLLON;
  while ((RCC->CR & RCC_CR_PLLRDY) != RCC_CR_PLLRDY);

  RCC->CFGR = (0b100 << RCC_CFGR_PPRE1_Pos) | (0b10 << RCC_CFGR_SW_Pos);
}
/* USER CODE END 4 */

void Error_Handler(void)
{
  __disable_irq();
  while (1)
  {
  }
}
