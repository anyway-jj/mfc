/* USER CODE BEGIN Header */
/**
  ******************************************************************************
  * @file           : main.c
  * @brief          : Main program body
  ******************************************************************************
  * @attention
  *
  * Copyright (c) 2023 STMicroelectronics.
  * All rights reserved.
  *
  * This software is licensed under terms that can be found in the LICENSE file
  * in the root directory of this software component.
  * If no LICENSE file comes with this software, it is provided AS-IS.
  *
  ******************************************************************************
  */
/* USER CODE END Header */
/* Includes ------------------------------------------------------------------*/
#include "main.h"

/* Private includes ----------------------------------------------------------*/
/* USER CODE BEGIN Includes */

/* USER CODE END Includes */

/* Private typedef -----------------------------------------------------------*/
/* USER CODE BEGIN PTD */

/* USER CODE END PTD */

/* Private define ------------------------------------------------------------*/
/* USER CODE BEGIN PD */
/* USER CODE END PD */

/* Private macro -------------------------------------------------------------*/
/* USER CODE BEGIN PM */

/* USER CODE END PM */

/* Private variables ---------------------------------------------------------*/

/* USER CODE BEGIN PV */
uint8_t first_data = 1;
const unsigned char hello_world [] = {
0x00, 0x00, 0x00, 0x00, 0x00, 0x00, 0xF0, 0xF0, 0x00, 0x00, 0x00, 0x00, 0xF0, 0xF0, 0x00, 0x00,
0xF0, 0xF0, 0x30, 0x30, 0x30, 0x30, 0x30, 0x30, 0x00, 0x00, 0xF0, 0xF0, 0x00, 0x00, 0x00, 0x00,
0x00, 0x00, 0x00, 0x00, 0xF0, 0xF0, 0x00, 0x00, 0x00, 0x00, 0x00, 0x00, 0x00, 0x00, 0xC0, 0xC0,
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0x0C, 0x0C, 0x0C, 0x0C, 0x03, 0x03, 0x00, 0x00, 0x00, 0x00, 0x00, 0x00, 0x00, 0x00, 0x00, 0x00
};
/* USER CODE END PV */

/* Private function prototypes -----------------------------------------------*/
void SystemClock_Config(void);
/* USER CODE BEGIN PFP */
void write_w(uint8_t word);
void write_i(uint8_t ins);
void write_d(uint8_t data);
void send_addr(uint8_t addr);
void init_OLED(void);

/* USER CODE END PFP */

/* Private user code ---------------------------------------------------------*/
/* USER CODE BEGIN 0 */

/* USER CODE END 0 */

/**
  * @brief  The application entry point.
  * @retval int
  */
int main(void)
{
  /* USER CODE BEGIN 1 */

  /* USER CODE END 1 */

  /* MCU Configuration--------------------------------------------------------*/

  /* Reset of all peripherals, Initializes the Flash interface and the Systick. */
  HAL_Init();

  /* USER CODE BEGIN Init */

  /* USER CODE END Init */

  /* Configure the system clock */
  SystemClock_Config();

  /* USER CODE BEGIN SysInit */

  /* USER CODE END SysInit */

  /* Initialize all configured peripherals */
  /* USER CODE BEGIN 2 */
  RCC->AHB1ENR |= RCC_AHB1ENR_GPIOBEN;
  RCC->APB1ENR |= RCC_APB1ENR_I2C1EN;

  GPIOB->PUPDR |= (0b01 << GPIO_PUPDR_PUPD6_Pos) | (0b01 << GPIO_PUPDR_PUPD7_Pos);
  GPIOB->AFR[0] |= (0b0100 << GPIO_AFRL_AFSEL6_Pos) | (0b0100 << GPIO_AFRL_AFSEL7_Pos);
  GPIOB->MODER |= (0b10 << GPIO_MODER_MODER6_Pos) | (0b10 << GPIO_MODER_MODER7_Pos);

  I2C1->CR1 |= (I2C_CR1_SWRST);
  I2C1->CR1 &= ~(I2C_CR1_SWRST);
  I2C1->CR2 = (0b010000 << I2C_CR2_FREQ_Pos);
  //I2C1->CCR = (0b0 << I2C_CCR_FS_Pos) | (1600 << I2C_CCR_CCR_Pos); //Sm mode, Tsck = 10 kHz
  I2C1->CCR = (0b0 << I2C_CCR_FS_Pos) | (80 << I2C_CCR_CCR_Pos); //Sm mode, Tsck = 100 kHz
  I2C1->TRISE = (17 << I2C_TRISE_TRISE_Pos);                       //(1000/62.5)+1 = 17
  I2C1->CR1 = I2C_CR1_PE;

  init_OLED();

  for (int i = 0; i < 512; i++) {
  	write_d(hello_world[i]);
  }
  /* USER CODE END 2 */

  /* Infinite loop */
  /* USER CODE BEGIN WHILE */
  while (1)
  {
    /* USER CODE END WHILE */

    /* USER CODE BEGIN 3 */
  }
  /* USER CODE END 3 */
}

/**
  * @brief System Clock Configuration
  * @retval None
  */
void SystemClock_Config(void)
{
  RCC_OscInitTypeDef RCC_OscInitStruct = {0};
  RCC_ClkInitTypeDef RCC_ClkInitStruct = {0};

  /** Configure the main internal regulator output voltage
  */
  __HAL_RCC_PWR_CLK_ENABLE();
  __HAL_PWR_VOLTAGESCALING_CONFIG(PWR_REGULATOR_VOLTAGE_SCALE2);

  /** Initializes the RCC Oscillators according to the specified parameters
  * in the RCC_OscInitTypeDef structure.
  */
  RCC_OscInitStruct.OscillatorType = RCC_OSCILLATORTYPE_HSI;
  RCC_OscInitStruct.HSIState = RCC_HSI_ON;
  RCC_OscInitStruct.HSICalibrationValue = RCC_HSICALIBRATION_DEFAULT;
  RCC_OscInitStruct.PLL.PLLState = RCC_PLL_NONE;
  if (HAL_RCC_OscConfig(&RCC_OscInitStruct) != HAL_OK)
  {
    Error_Handler();
  }

  /** Initializes the CPU, AHB and APB buses clocks
  */
  RCC_ClkInitStruct.ClockType = RCC_CLOCKTYPE_HCLK|RCC_CLOCKTYPE_SYSCLK
                              |RCC_CLOCKTYPE_PCLK1|RCC_CLOCKTYPE_PCLK2;
  RCC_ClkInitStruct.SYSCLKSource = RCC_SYSCLKSOURCE_HSI;
  RCC_ClkInitStruct.AHBCLKDivider = RCC_SYSCLK_DIV1;
  RCC_ClkInitStruct.APB1CLKDivider = RCC_HCLK_DIV1;
  RCC_ClkInitStruct.APB2CLKDivider = RCC_HCLK_DIV1;

  if (HAL_RCC_ClockConfig(&RCC_ClkInitStruct, FLASH_LATENCY_0) != HAL_OK)
  {
    Error_Handler();
  }
}

/* USER CODE BEGIN 4 */
void init_OLED(void) {
  write_i(0xAE); /*display off*/
  write_i(0x00); /*set lower column address*/
  write_i(0x10); /*set higher column address*/
  write_i(0x00); /*set display start line*/
  write_i(0xB0); /*set page address*/
  write_i(0x81); /*contract control*/
  write_i(0xff); /*128*/
  write_i(0xA1); /*set segment remap*/
  write_i(0xA6); /*normal / reverse*/
  write_i(0xA8); /*multiplex ratio*/
  write_i(0x1F); /*duty = 1/32*/
  write_i(0xC8); /*Com scan direction*/
  write_i(0xD3); /*set display offset*/
  write_i(0x00);
  write_i(0xD5); /*set osc division*/
  write_i(0x80);
  write_i(0xD9); /*set pre-charge period*/
  write_i(0x1f);
  write_i(0xDA); /*set COM pins*/
  write_i(0x00);
  write_i(0xdb); /*set vcomh*/
  write_i(0x40);
  write_i(0x8d); /*set charge pump enable*/
  write_i(0x14);
  write_i(0x20);
  write_i(0x00); //HORIZONTAL ADDRESING MODE
  //write_i(0x01); //VERTICAL ADDRESING MODE
  write_i(0x21);
  write_i(0);
  write_i(127);
  write_i(0x22);
  write_i(0);
  write_i(3);
  write_i(0xAF); /*display ON*/
}


void write_i(uint8_t ins) {
  I2C1->CR1 |= I2C_CR1_START;
  while ( ((I2C1->SR1 & I2C_SR1_SB) != I2C_SR1_SB));
  I2C1->SR1;
  send_addr(0x78);
  write_w(0x00);
  write_w(ins);
  first_data = 1;
  while ( (I2C1->SR1 & I2C_SR1_TXE) != I2C_SR1_TXE);
  I2C1->CR1 |= I2C_CR1_STOP;
}

void write_d(uint8_t ins) {
  I2C1->CR1 |= I2C_CR1_START;
  while ( ((I2C1->SR1 & I2C_SR1_SB) != I2C_SR1_SB));
  I2C1->SR1;
  send_addr(0x78);
  write_w(0x40);
  write_w(ins);
  first_data = 1;
  while ( (I2C1->SR1 & I2C_SR1_TXE) != I2C_SR1_TXE);
  I2C1->CR1 |= I2C_CR1_STOP;
}

void send_addr(uint8_t addr) {
  I2C1->DR = addr;
  while ( (I2C1->SR1 & I2C_SR1_ADDR) != I2C_SR1_ADDR);
  I2C1->SR1;
  I2C1->SR2;
}

void write_w(uint8_t word) {
  while ( (I2C1->SR1 & I2C_SR1_TXE) != I2C_SR1_TXE);
  I2C1->DR = word;
  if (first_data == 1) {
    first_data = 0;
	while ( (I2C1->SR1 & I2C_SR1_BTF) != I2C_SR1_BTF);
  }
}

/* USER CODE END 4 */

/**
  * @brief  This function is executed in case of error occurrence.
  * @retval None
  */
void Error_Handler(void)
{
  /* USER CODE BEGIN Error_Handler_Debug */
  /* User can add his own implementation to report the HAL error return state */
  __disable_irq();
  while (1)
  {
  }
  /* USER CODE END Error_Handler_Debug */
}

#ifdef  USE_FULL_ASSERT
/**
  * @brief  Reports the name of the source file and the source line number
  *         where the assert_param error has occurred.
  * @param  file: pointer to the source file name
  * @param  line: assert_param error line source number
  * @retval None
  */
void assert_failed(uint8_t *file, uint32_t line)
{
  /* USER CODE BEGIN 6 */
  /* User can add his own implementation to report the file name and line number,
     ex: printf("Wrong parameters value: file %s on line %d\r\n", file, line) */
  /* USER CODE END 6 */
}
#endif /* USE_FULL_ASSERT */
